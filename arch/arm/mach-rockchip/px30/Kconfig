## arch/arm/mach-rockchip/px30/Kconfig
```kconfig
if ROCKCHIP_PX30

config TARGET_EVB_PX30
	bool "EVB_PX30"

config ROCKCHIP_BOOT_MODE_REG
	default 0xff010200

config SYS_SOC
	default "px30"

config SYS_MALLOC_F_LEN
	default 0x400

config SPL_SERIAL_SUPPORT
	default y

config TPL_LDSCRIPT
	default "arch/arm/mach-rockchip/u-boot-tpl-v8.lds"

config TPL_TEXT_BASE
	default 0xff0e1000

config TPL_MAX_SIZE
	default 10240

config TPL_STACK
	default 0xff0e4fff

config ROCKCHIP_RK3326
	bool "Support Rockchip RK3326 "
	help
	  RK3326 can use most code from PX30, but at some situations we have
	  to distinguish between RK3326 and PX30, so this macro gives help.
	  It is usually selected in rk3326 board defconfig.

config DEBUG_UART2_CHANNEL
	int "Mux channel to use for debug UART2"
	depends on DEBUG_UART_BOARD_INIT
	default 0
	help
	  UART2 can use two different set of pins to route the output.
	  For using the UART for early debugging the route to use needs
	  to be declared (0 or 1).

source "board/rockchip/evb_px30/Kconfig"

endif
```

## arch/arm/mach-rockchip/rk3128/Kconfig
```kconfig
if ROCKCHIP_RK3128

choice
	prompt "RK3128 board select"

config TARGET_EVB_RK3128
	bool "RK3128 evaluation board"
	select BOARD_LATE_INIT
	help
	  RK3128evb is a evaluation board for Rockchip rk3128,
	  with full function and phisical connectors support like
	  usb2.0 host ports, LVDS, JTAG, MAC, SDcard, HDMI, USB-2-serial...

config TARGET_FIREPRIME_RK3128
	bool "RK3128 Fireprime board"
	select BOARD_LATE_INIT

endchoice

config SYS_SOC
	default "rockchip"

config SYS_MALLOC_F_LEN
	default 0x0800

config SPL_SERIAL_SUPPORT
	default y

source "board/firefly/fireprime-rk3128/Kconfig"
source "board/rockchip/evb_rk3128/Kconfig"

endif
```

## arch/arm/mach-rockchip/rk3188/Kconfig
```kconfig
if ROCKCHIP_RK3188

config SYS_SOC
	default "rockchip"

config SYS_MALLOC_F_LEN
	default 0x0800

endif
```

## arch/arm/mach-rockchip/rk322x/Kconfig
```kconfig
if ROCKCHIP_RK322X

config TARGET_A95X_R1
	bool "Nexbox A95X R1"
	select BOARD_LATE_INIT

config TARGET_EVB_RK3229
	bool "EVB_RK3229"
	select BOARD_LATE_INIT

choice
	prompt "UART2 channel used"

	config ROCKCHIP_RK322X_UART2_CHAN0
		bool "RK322x uart2 channel 0"
		help
		 The debug uart can take one of two routings to different
		 soc pins for its RX signal which needs to be configured
		 in a GRF setting depending on the layout of the board.

		 This option will use channel 0 whose pins are shared with
		 the sdmmc controller.

	config ROCKCHIP_RK322X_UART2_CHAN1
		bool "RK322x uart2 channel 1"
		help
		 The debug uart can take one of two routings to different
		 soc pins for its RX signal which needs to be configured
		 in a GRF setting depending on the layout of the board.

		 This option will use channel 1 whose pins are shared with
		 with the uart1 and spi2 controllers.

endchoice

config SYS_SOC
	default "rockchip"

config SYS_MALLOC_F_LEN
	default 0x400

config SPL_SERIAL_SUPPORT
	default y

source "board/nexbox/a95x_r1/Kconfig"
source "board/rockchip/evb_rk3229/Kconfig"

endif
```

## arch/arm/mach-rockchip/rk3368/Kconfig
```kconfig
if ROCKCHIP_RK3368

config TARGET_R88_RK3368
	bool "R88-RK3368"
	help
	  Firefly is a RK3288-based development board with 2 USB ports,
	  HDMI, VGA, micro-SD card, audio, WiFi  and Gigabit Ethernet, It
	  also includes on-board eMMC and 1GB of SDRAM. Expansion connectors
	  provide access to display pins, I2C, SPI, UART and GPIOs.

config SYS_SOC
	default "rockchip"

config SYS_MALLOC_F_LEN
	default 0x0800

source "board/rockchip/r88-rk3368/Kconfig"

endif
```

## board/firefly/fireprime-rk3128/Kconfig
```kconfig
if TARGET_FIREPRIME_RK3128

config SYS_BOARD
	default "fireprime-rk3128"

config SYS_VENDOR
	default "firefly"

config SYS_CONFIG_NAME
	default "fireprime-rk3128"

config BOARD_SPECIFIC_OPTIONS # dummy
	def_bool y

endif
```

## board/nexbox/a95x_r1/Kconfig
```kconfig
if TARGET_A95X_R1

config SYS_BOARD
	default "a95x_r1"

config SYS_VENDOR
	default "nexbox"

config SYS_CONFIG_NAME
	default "a95x_r1"

config BOARD_SPECIFIC_OPTIONS # dummy
	def_bool y

endif
```

## board/qnap/ts433_rk3568/Kconfig
```kconfig
if TARGET_QNAP_TS433_RK3568

config SYS_BOARD
	default "ts433_rk3568"

config SYS_VENDOR
	default "qnap"

config SYS_CONFIG_NAME
	default "ts433_rk3568"

endif
```

## board/qnap/tsx33_rk356x/Kconfig
```kconfig
if TARGET_QNAP_TSX33_RK356X

config SYS_BOARD
	default "tsx33_rk356x"

config SYS_VENDOR
	default "qnap"

config SYS_CONFIG_NAME
	default "tsx33_rk356x"

endif
```

## board/radxa/radxa-rock/Kconfig
```kconfig
if TARGET_RADXA_ROCK

config SYS_BOARD
	default "radxa-rock"

config SYS_VENDOR
	default "radxa"

config SYS_CONFIG_NAME
	default "radxa-rock"

config BOARD_SPECIFIC_OPTIONS # dummy
	def_bool y

endif
```

## board/rockchip/evb_rk3288/fit_spl_atf.its
```
/* SPDX-License-Identifier: GPL-2.0+ OR X11 */
/*
 * Copyright (C) 2017 Theobroma Systems Design und Consulting GmbH
 *
 * Minimal dts for a SPL FIT image payload.
 */

/dts-v1/;

/ {
	description = "FIT image with U-Boot proper, ATF bl32, DTB";
	#address-cells = <1>;

	images {
		uboot {
			description = "U-Boot (64-bit)";
			data = /incbin/("../../../u-boot-nodtb.bin");
			type = "standalone";
			os = "U-Boot";
			arch = "arm64";
			compression = "none";
			load = <0x00200000>;
		};
		atf {
			description = "ARM Trusted Firmware";
			data = /incbin/("../../../bl32-rk3288.bin");
			type = "firmware";
			os = "arm-trusted-firmware";
			arch = "arm64";
			compression = "none";
			load = <0x00100000>;
			entry = <0x00100000>;
		};

		fdt {
			description = "RK3288-EVB flat device-tree";
			data = /incbin/("../../../u-boot.dtb");
			type = "flat_dt";
			compression = "none";
		};
	};

	configurations {
		default = "conf";
		conf {
			description = "Rockchip RK3288-EVB";
			firmware = "atf";
			loadables = "uboot";
			fdt = "fdt";
		};
	};
};
```

## board/rockchip/r88-rk3368/Kconfig
```kconfig
if TARGET_R88_RK3368

config SYS_BOARD
	default "r88-rk3368"

config SYS_VENDOR
	default "rockchip"

config SYS_CONFIG_NAME
	default "r88-rk3368"

config BOARD_SPECIFIC_OPTIONS # dummy
	def_bool y

endif
```

## configs/r88-rk3368_defconfig
```kconfig
CONFIG_ARM=y
CONFIG_ARCH_ROCKCHIP=y
CONFIG_SYS_MALLOC_F_LEN=0x2000
CONFIG_ROCKCHIP_RK3368=y
CONFIG_TARGET_R88_RK3368=y
CONFIG_DEFAULT_DEVICE_TREE="rk3368-r88"
CONFIG_HUSH_PARSER=y
CONFIG_CMD_BOOTZ=y
# CONFIG_CMD_IMLS is not set
CONFIG_CMD_MMC=y
CONFIG_CMD_SF=y
CONFIG_CMD_SPI=y
CONFIG_CMD_I2C=y
CONFIG_CMD_GPIO=y
# CONFIG_CMD_SETEXPR is not set
CONFIG_CMD_DHCP=y
CONFIG_CMD_MII=y
CONFIG_CMD_PING=y
CONFIG_CMD_CACHE=y
CONFIG_CMD_TIME=y
CONFIG_CMD_PMIC=y
CONFIG_CMD_REGULATOR=y
CONFIG_CMD_EXT2=y
CONFIG_CMD_EXT4=y
CONFIG_CMD_FAT=y
CONFIG_CMD_FS_GENERIC=y
CONFIG_REGMAP=y
CONFIG_SYSCON=y
CONFIG_CLK=y
CONFIG_ROCKCHIP_GPIO=y
CONFIG_SYS_I2C_ROCKCHIP=y
CONFIG_LED=y
CONFIG_LED_GPIO=y
CONFIG_SYSRESET=y
CONFIG_DM_MMC=y
CONFIG_ROCKCHIP_DWMMC=y
CONFIG_PINCTRL=y
CONFIG_ROCKCHIP_PINCTRL=y
CONFIG_ROCKCHIP_RK3368_PINCTRL=y
CONFIG_DM_PMIC=y
CONFIG_DM_REGULATOR=y
CONFIG_DM_REGULATOR_FIXED=y
CONFIG_DM_PWM=y
CONFIG_PWM_ROCKCHIP=y
CONFIG_RAM=y
CONFIG_DEBUG_UART=y
CONFIG_DEBUG_UART_BASE=0xff690000
CONFIG_DEBUG_UART_CLOCK=24000000
CONFIG_DEBUG_UART_SHIFT=2
CONFIG_SYS_NS16550=y
CONFIG_DM_VIDEO=y
CONFIG_USE_PRIVATE_LIBGCC=y
CONFIG_USE_TINY_PRINTF=y
CONFIG_CMD_DHRYSTONE=y
CONFIG_ERRNO_STR=y
```

## drivers/ram/rockchip/Kconfig
```kconfig
config RAM_ROCKCHIP
	bool "Ram drivers support for Rockchip SoCs"
	depends on RAM && ARCH_ROCKCHIP
	default y
	help
	  This enables support for ram drivers Rockchip SoCs.

config ROCKCHIP_SDRAM_COMMON
	bool "Enable rockchip sdram common driver"
	depends on TPL_RAM || SPL_RAM
	help
	  This enable sdram common driver

config RAM_RK3399_LPDDR4
	bool "LPDDR4 support for Rockchip RK3399"
	depends on RAM_ROCKCHIP && ROCKCHIP_RK3399
	help
	  This enables LPDDR4 sdram code support for the platforms based
	  on Rockchip RK3399 SoC.
```
