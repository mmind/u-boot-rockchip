// SPDX-License-Identifier: GPL-2.0+
/*
 * (C) Copyright 2024 Heiko Stuebner <heiko@sntech.de>
 */

#include "rk356x-u-boot.dtsi"

&sdhci {
	cap-mmc-highspeed;
	mmc-hs400-1_8v;
	mmc-hs400-enhanced-strobe;
	pinctrl-0 = <&emmc_bus8 &emmc_clk &emmc_cmd &emmc_datastrobe>;
};
